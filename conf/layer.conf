## conf/layer.conf
```bitbake
# We have a conf and classes directory, add to BBPATH
BBPATH .= ":${LAYERDIR}"

# We have recipes-* directories, add to BBFILES
BBFILES += "${LAYERDIR}/recipes-*/*/*.bb \
            ${LAYERDIR}/recipes-*/*/*.bbappend"

BBFILE_COLLECTIONS += "meta-microchip-azure"
BBFILE_PATTERN_meta-microchip-azure = "^${LAYERDIR}/"
BBFILE_PRIORITY_meta-microchip-azure = "11"

LAYERDEPENDS_meta-microchip-azure = "core"
LAYERSERIES_COMPAT_meta-microchip-azure = "dunfell"
```
